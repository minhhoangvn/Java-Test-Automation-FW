## TA/com.mh.ta.core/sample.yaml
```yaml
name: Test MHTAFW
parallel: methods
configFailurePolicy: skip
tests:
  - name: DriverFactory
    parallel: methods
    groupByInstances: true
    classes:
      - com.mh.ta.login.TestLogin
```
